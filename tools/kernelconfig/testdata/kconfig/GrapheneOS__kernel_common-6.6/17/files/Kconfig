## tools/kernelconfig/testdata/kconfig/GrapheneOS__kernel_common-6.6/17/files/arch/arm64/Kconfig
```kconfig
# Fixture arch Kconfig.

config ARM64
	bool "ARM64 support"

config ARM64_ONLY_SYM
	bool "arm64-only symbol"
	depends on ARM64
```

## tools/kernelconfig/testdata/kconfig/GrapheneOS__kernel_common-6.6/17/files/drivers/test/Kconfig
```kconfig
# Fixture driver Kconfig.

config TEST_DRV
	bool "test driver"
	depends on TEST_MM && TEST_MISSING

config TEST_DRV_SEL
	bool "test driver with select"
	select TEST_FORCED

config TEST_FORCED
	bool "forced by select"

config TEST_MISSING
	bool "symbol exists in tree but never set by fragments"
```

## tools/kernelconfig/testdata/kconfig/GrapheneOS__kernel_common-6.6/17/files/mm/Kconfig
```kconfig
# Fixture mm Kconfig.

config TEST_MM
	bool "test mm option"

config TEST_PROMPTLESS
	def_bool y

config TEST_STR
	string
	default "zzz"
```
